## arch/arm64/configs/aio_5m_defconfig
```kconfig
CONFIG_CROSS_COMPILE="aarch64-linux-android-"
# CONFIG_LOCALVERSION_AUTO is not set
CONFIG_AUDIT=y
CONFIG_NO_HZ=y
CONFIG_HIGH_RES_TIMERS=y
CONFIG_RCU_FANOUT=32
CONFIG_CGROUPS=y
CONFIG_CGROUP_CPUACCT=y
CONFIG_CGROUP_SCHED=y
CONFIG_RT_GROUP_SCHED=y
CONFIG_BLK_DEV_INITRD=y
CONFIG_PANIC_TIMEOUT=5
CONFIG_SYSCTL_SYSCALL=y
CONFIG_EMBEDDED=y
CONFIG_PROFILING=y
# CONFIG_BLK_DEV_BSG is not set
CONFIG_ARCH_MT6752=y
CONFIG_MTK_PSCI=y
CONFIG_SMP=y
CONFIG_SCHED_MC=y
CONFIG_NR_CPUS=8
CONFIG_PREEMPT=y
# CONFIG_BOUNCE is not set
CONFIG_SECCOMP=y
CONFIG_CMDLINE="console=tty0 console=ttyMT3,921600n1 root=/dev/ram vmalloc=496M slub_max_order=0 slub_debug=O "
CONFIG_BUILD_ARM64_APPENDED_DTB_IMAGE=y
CONFIG_BUILD_ARM64_APPENDED_DTB_IMAGE_NAMES="aio_otfp_drvonly"
CONFIG_CPU_FREQ=y
CONFIG_CPU_FREQ_STAT_DETAILS=y
CONFIG_CPU_FREQ_DEFAULT_GOV_INTERACTIVE=y
CONFIG_CPU_FREQ_GOV_PERFORMANCE=y
CONFIG_CPU_FREQ_GOV_POWERSAVE=y
CONFIG_CPU_FREQ_GOV_USERSPACE=y
CONFIG_CPU_FREQ_GOV_ONDEMAND=y
# CONFIG_CORE_DUMP_DEFAULT_ELF_HEADERS is not set
CONFIG_COMPAT=y
CONFIG_HIBERNATION=y
# CONFIG_TOI_FILE is not set
CONFIG_TOI_DEFAULT_WAIT=2
CONFIG_PM_AUTOSLEEP=y
CONFIG_PM_WAKELOCKS=y
CONFIG_NET=y
CONFIG_PACKET=y
CONFIG_UNIX=y
CONFIG_XFRM_USER=y
CONFIG_XFRM_SUB_POLICY=y
CONFIG_XFRM_MIGRATE=y
CONFIG_NET_KEY=y
CONFIG_INET=y
CONFIG_IP_MULTICAST=y
CONFIG_IP_ADVANCED_ROUTER=y
CONFIG_IP_MULTIPLE_TABLES=y
CONFIG_IP_PNP=y
CONFIG_IP_PNP_DHCP=y
CONFIG_IP_PNP_BOOTP=y
CONFIG_NET_IPIP=y
CONFIG_IP_MROUTE=y
CONFIG_IP_MROUTE_MULTIPLE_TABLES=y
CONFIG_IP_PIMSM_V1=y
CONFIG_IP_PIMSM_V2=y
CONFIG_ARPD=y
CONFIG_SYN_COOKIES=y
CONFIG_INET_AH=y
CONFIG_INET_ESP=y
CONFIG_INET_IPCOMP=y
# CONFIG_INET_LRO is not set
CONFIG_IPV6_PRIVACY=y
CONFIG_IPV6_ROUTER_PREF=y
CONFIG_IPV6_ROUTE_INFO=y
CONFIG_IPV6_OPTIMISTIC_DAD=y
CONFIG_INET6_AH=y
CONFIG_INET6_ESP=y
CONFIG_INET6_IPCOMP=y
CONFIG_IPV6_MIP6=y
CONFIG_INET6_XFRM_MODE_ROUTEOPTIMIZATION=y
CONFIG_IPV6_SIT_6RD=y
CONFIG_IPV6_TUNNEL=y
CONFIG_IPV6_MULTIPLE_TABLES=y
CONFIG_IPV6_SUBTREES=y
CONFIG_IPV6_MROUTE=y
CONFIG_IPV6_PIMSM_V2=y
CONFIG_NETFILTER=y
CONFIG_NF_CONNTRACK=y
CONFIG_NF_CONNTRACK_EVENTS=y
CONFIG_NF_CT_PROTO_UDPLITE=y
CONFIG_NF_CONNTRACK_FTP=y
CONFIG_NF_CONNTRACK_PPTP=y
CONFIG_NF_CONNTRACK_SIP=y
CONFIG_NF_CONNTRACK_TFTP=y
CONFIG_NF_CT_NETLINK=y
CONFIG_NETFILTER_TPROXY=y
CONFIG_NETFILTER_XT_CONNMARK=y
CONFIG_NETFILTER_XT_TARGET_CLASSIFY=y
CONFIG_NETFILTER_XT_TARGET_IDLETIMER=y
CONFIG_NETFILTER_XT_TARGET_MARK=y
CONFIG_NETFILTER_XT_TARGET_NFLOG=y
CONFIG_NETFILTER_XT_TARGET_NFQUEUE=y
CONFIG_NETFILTER_XT_TARGET_TCPMSS=y
CONFIG_NETFILTER_XT_MATCH_CONNBYTES=y
CONFIG_NETFILTER_XT_MATCH_IPRANGE=y
CONFIG_NETFILTER_XT_MATCH_LENGTH=y
CONFIG_NETFILTER_XT_MATCH_LIMIT=y
CONFIG_NETFILTER_XT_MATCH_MAC=y
CONFIG_NETFILTER_XT_MATCH_MARK=y
CONFIG_NETFILTER_XT_MATCH_MULTIPORT=y
CONFIG_NETFILTER_XT_MATCH_POLICY=y
CONFIG_NETFILTER_XT_MATCH_PHYSDEV=y
CONFIG_NETFILTER_XT_MATCH_QTAGUID=y
CONFIG_NETFILTER_XT_MATCH_QUOTA=y
CONFIG_NETFILTER_XT_MATCH_QUOTA2=y
CONFIG_NETFILTER_XT_MATCH_QUOTA2_LOG=y
CONFIG_NETFILTER_XT_MATCH_REALM=y
CONFIG_NETFILTER_XT_MATCH_RECENT=y
CONFIG_NETFILTER_XT_MATCH_SOCKET=y
CONFIG_NETFILTER_XT_MATCH_STATE=y
CONFIG_NETFILTER_XT_MATCH_STATISTIC=y
CONFIG_NETFILTER_XT_MATCH_STRING=y
CONFIG_NETFILTER_XT_MATCH_TCPMSS=y
CONFIG_NETFILTER_XT_MATCH_TIME=y
CONFIG_NETFILTER_XT_MATCH_U32=y
CONFIG_NF_CONNTRACK_IPV4=y
CONFIG_IP_NF_IPTABLES=y
CONFIG_IP_NF_FILTER=y
CONFIG_IP_NF_TARGET_REJECT=y
CONFIG_NF_NAT_IPV4=y
CONFIG_IP_NF_TARGET_MASQUERADE=y
CONFIG_IP_NF_TARGET_NETMAP=y
CONFIG_IP_NF_TARGET_REDIRECT=y
CONFIG_IP_NF_MANGLE=y
CONFIG_IP_NF_RAW=y
CONFIG_IP_NF_ARPTABLES=y
CONFIG_NF_CONNTRACK_IPV6=y
CONFIG_IP6_NF_IPTABLES=y
CONFIG_IP6_NF_MATCH_FRAG=y
CONFIG_IP6_NF_MATCH_IPV6HEADER=y
CONFIG_IP6_NF_TARGET_HL=y
CONFIG_IP6_NF_FILTER=y
CONFIG_IP6_NF_TARGET_REJECT=y
CONFIG_IP6_NF_TARGET_REJECT_SKERR=y
CONFIG_IP6_NF_MANGLE=y
CONFIG_IP6_NF_RAW=y
CONFIG_BRIDGE=y
CONFIG_VLAN_8021Q=y
CONFIG_NET_SCHED=y
CONFIG_NET_SCH_HTB=y
CONFIG_NET_SCH_INGRESS=y
CONFIG_NET_CLS_FW=y
CONFIG_NET_CLS_U32=y
CONFIG_CLS_U32_PERF=y
CONFIG_CLS_U32_MARK=y
CONFIG_NET_CLS_FLOW=y
CONFIG_NET_CLS_ACT=y
CONFIG_NET_ACT_POLICE=y
CONFIG_NET_ACT_MIRRED=y
CONFIG_NET_ACT_IPT=y
CONFIG_NET_CLS_IND=y
CONFIG_NET_DROP_MONITOR=y
CONFIG_CFG80211=y
CONFIG_NL80211_TESTMODE=y
CONFIG_CFG80211_DEVELOPER_WARNINGS=y
# CONFIG_CFG80211_DEFAULT_PS is not set
CONFIG_CFG80211_DEBUGFS=y
CONFIG_CFG80211_INTERNAL_REGDB=y
CONFIG_CFG80211_WEXT=y
CONFIG_CFG80211_ALLOW_RECONNECT=y
CONFIG_MTD=y
CONFIG_MTD_BLOCK=y
CONFIG_MTD_NAND_IDS=y
CONFIG_BLK_DEV_LOOP=y
# CONFIG_ANDROID_PMEM is not set
CONFIG_UID_STAT=y
CONFIG_MEDIATEK_SOLUTION=y
CONFIG_MTK_PLATFORM="mt6752"
CONFIG_ARCH_MTK_PROJECT="aio_otfp_drvonly"
CONFIG_MTK_CIRQ=y
CONFIG_HAVE_AEE_FEATURE=y
CONFIG_HAVE_XLOG_SUPPORT=y
CONFIG_HAVE_XLOG_PRINTK=y
CONFIG_MTK_NEW_COMBO_EMMC_SUPPORT=y
CONFIG_MTK_SHARED_SDCARD=y
CONFIG_MTK_MULTI_STORAGE_SUPPORT=y
CONFIG_MD32_SUPPORT=y
CONFIG_MTK_MEMCFG=y
CONFIG_MTK_SMARTBOOK_SUPPORT=y
CONFIG_MTK_SENSOR_SUPPORT=y
# CONFIG_MTK_SENSOR_HUB_SUPPORT is not set
#lenovo sw wangyq13 modify 20151012 begin
CONFIG_CUSTOM_KERNEL_LCM="hx8395a_hd720_dsi_vdo_tm"
CONFIG_LCM_HEIGHT="1920"
CONFIG_LCM_WIDTH="1080"
#lenovo sw wangyq13 modify 20151012 end
#lenovo.sw START zhangjiano change imgsensor config for sisley2
CONFIG_CUSTOM_KERNEL_IMGSENSOR="ov13850sunny_mipi_raw ov13850ofilma50_mipi_raw ov5670_mipi_raw ov5670lite_mipi_raw"
#lenovo.sw END zhangjiano change imgsensor config for sisley2
CONFIG_CUSTOM_KERNEL_FLASHLIGHT="constant_flashlight"
CONFIG_MTK_MMPROFILE_SUPPORT=y
CONFIG_MTK_CLKMGR=y
CONFIG_MTK_SCHED_TRACERS=y
CONFIG_MTK_FTRACE_DEFAULT_ENABLE=y
CONFIG_MTK_MET=y
CONFIG_MTK_MET_PLF=y
CONFIG_MTK_AEE_FEATURE=y
CONFIG_MTK_AEE_POWERKEY_HANG_DETECT=y
# CONFIG_ANDROID_VMEM is not set
CONFIG_MTK_RAM_CONSOLE=y
CONFIG_MTK_RAM_CONSOLE_USING_DRAM=y
CONFIG_MTK_RAM_CONSOLE_SIZE=0x4000
CONFIG_MTK_RAM_CONSOLE_ADDR=0xF912c000
CONFIG_MTK_RAM_CONSOLE_DRAM_SIZE=0x10000
CONFIG_MTK_RAM_CONSOLE_DRAM_ADDR=0x43F00000
CONFIG_MT_SCHED_MONITOR=y
CONFIG_PRINTK_PROCESS_INFO=y
CONFIG_MT_PRINTK_UART_CONSOLE=y
CONFIG_MTK_COMPAT=y
CONFIG_MTK_SCHED_CMP=y
CONFIG_MTK_SCHED_CMP_TGS=y
CONFIG_MTK_SCHED_CMP_TGS_WAKEUP=y
CONFIG_GATOR_DRIVER=y
CONFIG_MTK_TETHERINGIPV6_SUPPORT=y
CONFIG_MTK_ACCDET=y
CONFIG_MTK_FB=y
CONFIG_MTK_DITHERING_SUPPORT=y
CONFIG_MTK_LCM_PHYSICAL_ROTATION="0"
CONFIG_MTK_BTIF=y
CONFIG_MTK_FM=y
CONFIG_MTK_FM_SUPPORT=y
CONFIG_MTK_FM_CHIP="MT6625_FM"
# CONFIG_POWER_EXT is not set
#lenovo sw chailu1 close  CONFIG_MTK_BQ24261_SUPPORT
#CONFIG_MTK_BQ24261_SUPPORT is not set
# CONFIG_MTK_SOUND is not set
CONFIG_MTK_TOUCHPANEL=y
CONFIG_USB_MTK_HDRC_GADGET=y
CONFIG_USB_MTK_OTG=y
CONFIG_USB_MTK_HDRC_HCD=y
CONFIG_ION_MTK=y
CONFIG_MMPROFILE=y
CONFIG_MTK_GPU_SUPPORT=y
CONFIG_MTK_KERNEL_POWER_OFF_CHARGING=y
#lenovo-sw molg1 mark for S2 begin
# CONFIG_CUSTOM_KERNEL_BAROMETER is not set
#lenovo-sw molg1 mark for S2 end
CONFIG_MTK_THERMAL_PA_VIA_ATCMD=y
CONFIG_MTK_SIM1_SOCKET_TYPE="1"
CONFIG_MTK_SIM2_SOCKET_TYPE="1"
CONFIG_MTK_BICR_SUPPORT=y
#lenovo.sw END zhangjiano add for sisley2 lens
CONFIG_MTK_LENS_DW9761SUNNYAF_SUPPORT=y
CONFIG_MTK_LENS_DW9761OFILMA50AF_SUPPORT=y
CONFIG_MTK_LENS_DW9761OFILMAF_SUPPORT=y
#lenovo.sw END zhangjiano add for sisley2 lens
#lenovo-sw zhangjiano add for sisley2 camera otp begin
CONFIG_MTK_CAM_CAL_OV13850SUNNY_SUPPORT=y
#lenovo-sw zhangjiano add for sisley2 camera otp end
CONFIG_MTK_CPU_STRESS=y
CONFIG_MTK_LASTPC=y
CONFIG_MTK_FMRADIO=y
CONFIG_MTK_HWMON=y
CONFIG_MTK_CMDQ=y
CONFIG_MTK_MT_LOGGER=y
CONFIG_MTK_LENS=y
CONFIG_MTK_IMGSENSOR=y
CONFIG_MTK_SYSENV=y
CONFIG_MTK_GPT_SCHEME_SUPPORT=y
CONFIG_MTK_SMI_EXT=y
CONFIG_MTK_BTCVSD=y
CONFIG_MTK_POWER_GS=y
CONFIG_MTK_COMBO=y
CONFIG_MTK_COMBO_CHIP_CONSYS_6752=y
CONFIG_MTK_COMBO_BT=y
CONFIG_MTK_COMBO_GPS=y
CONFIG_MTK_COMBO_WIFI=y
CONFIG_MTK_WAPI_SUPPORT=y
CONFIG_MTK_PASSPOINT_R1_SUPPORT=y
CONFIG_MTK_GPS_SUPPORT=y
#CONFIG_MTK_NFC=y
#CONFIG_NFC_MT6605=y
CONFIG_MTK_KEYPAD=y
CONFIG_MTK_LEDS=y
CONFIG_MTK_MMC=y
CONFIG_MTK_EMMC_SUPPORT=y
CONFIG_MTK_EMMC_CACHE=y
CONFIG_MTK_MJC_DRIVER=y
CONFIG_MTK_VIDEOCODEC_DRIVER=y
#Lenovo-sw lixp5 modify 2015-10-13 begin, for sisley2_M
#CONFIG_MTK_MD1_SUPPORT=5
#load LTG modem first
CONFIG_MTK_MD1_SUPPORT=6
CONFIG_MTK_UMTS_TDD128_MODE=y
#Lenovo-sw lixp5 modify 2015-10-13 end
CONFIG_MTK_ECCCI_DRIVER=y
CONFIG_MTK_ECCCI_CCIF=y
CONFIG_CUSTOM_KERNEL_SSW="ssw_generic_v2"
CONFIG_MTK_JPEG=y
CONFIG_MT_SCHED=y
CONFIG_MTK_SCHED_RQAVG_US=y
CONFIG_MTK_SCHED_RQAVG_KS=y
CONFIG_MTK_SYNC=y
#Sensor
#lenovo-sw molg1 add begin
#lenovo-sw chenlj2 modify start
CONFIG_CUSTOM_KERNEL_ACCELEROMETER=y
# CONFIG_MTK_BMA222E_SISLEY2 is not set
#lenovo-sw chenlj2 modify end
CONFIG_MTK_BMA222E_AIO=y
# CONFIG_MTK_MPU6515A is not set
# CONFIG_CUSTOM_KERNEL_ACTIVITY_SENSOR is not set
CONFIG_CUSTOM_KERNEL_ALSPS=y
# CONFIG_MTK_CM366XX is not set
CONFIG_MTK_EPL21822_AIO=y
# CONFIG_MTK_CM36652_NEW is not set
# CONFIG_MTK_BMP180_NEW is not set
# CONFIG_CUSTOM_KERNEL_FACE_DOWN_SENSOR is not set
# CONFIG_CUSTOM_KERNEL_GLANCE_GESTURE_SENSOR is not set
#CONFIG_CUSTOM_KERNEL_GYROSCOPE is not set
#CONFIG_MTK_MPU6515G is not set
# CONFIG_CUSTOM_KERNEL_IN_POCKET_SENSOR is not set
CONFIG_CUSTOM_KERNEL_MAGNETOMETER=y
CONFIG_MTK_AKM09911_AIO=y
# CONFIG_MTK_YAS532 is not set
# CONFIG_CUSTOM_KERNEL_PEDOMETER is not set
# CONFIG_CUSTOM_KERNEL_PICK_UP_SENSOR is not set
# CONFIG_CUSTOM_KERNEL_SENSORHUB is not set
# CONFIG_MTK_SCP_SENSORHUB is not set
# CONFIG_CUSTOM_KERNEL_SHAKE_SENSOR is not set
# CONFIG_CUSTOM_KERNEL_STEP_COUNTER is not set
# CONFIG_CUSTOM_KERNEL_SIGNIFICANT_MOTION_SENSOR is not set
# CONFIG_CUSTOM_KERNEL_TILT_DETECTOR_SENSOR is not set
# CONFIG_CUSTOM_KERNEL_WAKE_GESTURE_SENSOR is not set
#lenovo-sw molg1 add end
CONFIG_SCSI=y
CONFIG_SCSI_TGT=y
CONFIG_BLK_DEV_SD=y
CONFIG_SCSI_MULTI_LUN=y
CONFIG_SCSI_SCAN_ASYNC=y
# CONFIG_SCSI_LOWLEVEL is not set
CONFIG_MD=y
CONFIG_BLK_DEV_DM=y
CONFIG_DM_CRYPT=y
CONFIG_DM_UEVENT=y
CONFIG_DM_VERITY=y
CONFIG_NETDEVICES=y
CONFIG_IFB=y
CONFIG_TUN=y
# CONFIG_ETHERNET is not set
CONFIG_PPP=y
CONFIG_PPP_BSDCOMP=y
CONFIG_PPP_DEFLATE=y
CONFIG_PPP_FILTER=y
CONFIG_PPP_MPPE=y
CONFIG_PPP_MULTILINK=y
CONFIG_PPPOE=y
CONFIG_PPPOLAC=y
CONFIG_PPPOPNS=y
CONFIG_PPP_ASYNC=y
CONFIG_PPP_SYNC_TTY=y
# CONFIG_INPUT_MOUSEDEV is not set
CONFIG_INPUT_EVDEV=y
# CONFIG_INPUT_KEYBOARD is not set
# CONFIG_INPUT_MOUSE is not set
CONFIG_INPUT_TOUCHSCREEN=y
CONFIG_TOUCHSCREEN_MTK=y
CONFIG_TOUCHSCREEN_MTK_FHD=y
# CONFIG_TOUCHSCREEN_MTK_GT9XX_HOTKNOT_SCP=y
CONFIG_TOUCHSCREEN_MTK_GT9XX_AIO=y
CONFIG_INPUT_MISC=y
CONFIG_INPUT_UINPUT=y
# CONFIG_SERIO is not set
# CONFIG_VT is not set
CONFIG_LEGACY_PTY_COUNT=16
# CONFIG_DEVMEM is not set
# CONFIG_DEVKMEM is not set
# CONFIG_HW_RANDOM is not set
CONFIG_I2C=y
CONFIG_SPI=y
# CONFIG_HWMON is not set
CONFIG_THERMAL=y
CONFIG_THERMAL_DEFAULT_GOV_BACKWARD_COMPATIBLE=y
CONFIG_FB=y
CONFIG_FB_MODE_HELPERS=y
CONFIG_FB_TILEBLITTING=y
CONFIG_LOGO=y
# lenovo-sw,lily8,2014-11-27,add for piezo,begin
CONFIG_LENOVO_PIEZO=y
# lenovo-sw,lily8,2014-11-27,add for piezo,end
CONFIG_SOUND=y
CONFIG_SND=y
CONFIG_SND_SEQUENCER=y
CONFIG_SND_SEQ_DUMMY=y
CONFIG_SND_MIXER_OSS=y
CONFIG_SND_PCM_OSS=y
CONFIG_SND_SEQUENCER_OSS=y
CONFIG_SND_HRTIMER=y
CONFIG_SND_DYNAMIC_MINORS=y
CONFIG_SND_VERBOSE_PRINTK=y
CONFIG_SND_DEBUG=y
CONFIG_SND_DEBUG_VERBOSE=y
CONFIG_SND_PCM_XRUN_DEBUG=y
# CONFIG_SND_SPI is not set
CONFIG_SND_USB_AUDIO=y
CONFIG_SND_SOC=y
CONFIG_MT_SND_SOC_V2=y
CONFIG_MTK_SPEAKER=y
CONFIG_SND_SIMPLE_CARD=y
CONFIG_SOUND_PRIME=y
CONFIG_HIDRAW=y
CONFIG_UHID=y
CONFIG_HID_A4TECH=y
CONFIG_HID_APPLE=y
CONFIG_HID_BELKIN=y
CONFIG_HID_CHERRY=y
CONFIG_HID_CHICONY=y
CONFIG_HID_CYPRESS=y
CONFIG_HID_DRAGONRISE=y
CONFIG_HID_EZKEY=y
CONFIG_HID_KYE=y
CONFIG_HID_GYRATION=y
CONFIG_HID_TWINHAN=y
CONFIG_HID_KENSINGTON=y
CONFIG_HID_LOGITECH=y
CONFIG_HID_MAGICMOUSE=y
CONFIG_HID_MICROSOFT=y
CONFIG_HID_MONTEREY=y
CONFIG_HID_PANTHERLORD=y
CONFIG_HID_PETALYNX=y
CONFIG_HID_SAMSUNG=y
CONFIG_HID_SUNPLUS=y
CONFIG_HID_GREENASIA=y
CONFIG_HID_SMARTJOYPLUS=y
CONFIG_HID_TOPSEED=y
CONFIG_HID_THRUSTMASTER=y
CONFIG_HID_ZEROPLUS=y
CONFIG_USB=y
CONFIG_USB_STORAGE=y
CONFIG_USB_STORAGE_DATAFAB=y
CONFIG_USB_STORAGE_FREECOM=y
CONFIG_USB_STORAGE_ISD200=y
CONFIG_USB_STORAGE_USBAT=y
CONFIG_USB_STORAGE_SDDR09=y
CONFIG_USB_STORAGE_SDDR55=y
CONFIG_USB_STORAGE_JUMPSHOT=y
CONFIG_USB_STORAGE_ALAUDA=y
CONFIG_USB_STORAGE_ONETOUCH=y
CONFIG_USB_STORAGE_KARMA=y
CONFIG_USB_STORAGE_CYPRESS_ATACB=y
CONFIG_USB_TRANCEVIBRATOR=y
CONFIG_USB_PHY=y
CONFIG_NOP_USB_XCEIV=y
CONFIG_USB_GADGET=y
CONFIG_USB_GADGET_VBUS_DRAW=500
CONFIG_USB_G_ANDROID=y
CONFIG_MMC=y
CONFIG_MMC_UNSAFE_RESUME=y
CONFIG_MMC_BLOCK_MINORS=32
CONFIG_NEW_LEDS=y
CONFIG_LEDS_CLASS=y
CONFIG_LEDS_TRIGGERS=y
CONFIG_LEDS_TRIGGER_TIMER=y
CONFIG_SWITCH=y
CONFIG_RTC_CLASS=y
# CONFIG_RTC_SYSTOHC is not set
CONFIG_STAGING=y
CONFIG_ZSMALLOC=y
CONFIG_ZRAM=y
CONFIG_ZRAM_DEBUG=y
CONFIG_ANDROID=y
CONFIG_ASHMEM=y
CONFIG_ANDROID_LOGGER=y
CONFIG_ANDROID_LOW_MEMORY_KILLER=y
CONFIG_ANDROID_INTF_ALARM_DEV=y
CONFIG_SYNC=y
CONFIG_SW_SYNC=y
CONFIG_SW_SYNC_USER=y
CONFIG_ION=y
CONFIG_ANDROID_BINDER_IPC=y
CONFIG_EXT3_FS=y
# CONFIG_EXT3_DEFAULTS_TO_ORDERED is not set
CONFIG_EXT3_FS_POSIX_ACL=y
CONFIG_EXT4_FS=y
CONFIG_EXT4_FS_SECURITY=y
CONFIG_EXT4_DEBUG=y
CONFIG_QUOTA=y
CONFIG_QFMT_V2=y
CONFIG_FUSE_FS=y
CONFIG_ISO9660_FS=y
CONFIG_JOLIET=y
CONFIG_ZISOFS=y
CONFIG_MSDOS_FS=y
CONFIG_VFAT_FS=y
#Begin, Lenovo, wangxf14, Nov 05,2015, ARIESM-20
CONFIG_EXFAT_FS=y
#End, Lenovo, wangxf14, Nov 05,2015, ARIESM-20
CONFIG_TMPFS=y
# CONFIG_NETWORK_FILESYSTEMS is not set
CONFIG_NLS_CODEPAGE_437=y
CONFIG_NLS_CODEPAGE_950=y
CONFIG_NLS_ASCII=y
CONFIG_NLS_ISO8859_1=y
CONFIG_NLS_UTF8=y
CONFIG_PRINTK_TIME=y
CONFIG_FRAME_WARN=1400
CONFIG_PANIC_ON_OOPS=y

CONFIG_SCHEDSTATS=y
# CONFIG_DEBUG_BUGVERBOSE is not set
CONFIG_DEBUG_INFO=y
CONFIG_RCU_CPU_STALL_TIMEOUT=60
CONFIG_FAULT_INJECTION=y
CONFIG_ENABLE_DEFAULT_TRACERS=y
CONFIG_DYNAMIC_DEBUG=y
CONFIG_DMA_API_DEBUG=y
CONFIG_SECURITY=y
CONFIG_SECURITY_NETWORK=y
CONFIG_LSM_MMAP_MIN_ADDR=32768
CONFIG_SECURITY_SELINUX=y
CONFIG_SECURITY_SELINUX_BOOTPARAM=y
CONFIG_CRYPTO_NULL=y
CONFIG_CRYPTO_CTR=y
CONFIG_CRYPTO_XCBC=y
CONFIG_CRYPTO_SHA256=y
CONFIG_CRYPTO_TWOFISH=y
CONFIG_CRYPTO_LZO=y
# CONFIG_CRYPTO_ANSI_CPRNG is not set
# CONFIG_CRYPTO_HW is not set
CONFIG_ARM64_CRYPTO=y
CONFIG_CRYPTO_SHA2_ARM64_CE=y
CONFIG_CRYPTO_AES_ARM64_CE=y
CONFIG_CRYPTO_AES_ARM64_CE_BLK=y
CONFIG_LIBCRC32C=y
#Begin lenovo sw chailu1 add 
CONFIG_LENOVO_CHARGING_STANDARD_SUPPORT=y
CONFIG_LENOVO_THERMAL_SUPPORT=y
CONFIG_LENOVO_GESTURE_WAKEUP=y
CONFIG_LENOVO_HALL=y
CONFIG_LENOVO_PIEZO=y
CONFIG_LENOVO_PM_LOG=y
CONFIG_LENOVO_POWEROFF_CHARGING_UI=y
CONFIG_LENOVO_READ_FW_ID=y
CONFIG_LENOVO_RTC_SAVE_TIMEZONE_SUPPORT=y
CONFIG_LENOVO_THERMAL_SUPPORT=y

# CONFIG_MTK_EPL21822 is not set
CONFIG_MTK_NCP1854_SUPPORT=y
# CONFIG_MTK_MT6306_SUPPORT is not set
CONFIG_MTK_GPU_VERSION="mali midgard r7p0"
CONFIG_LENOVO_CUSTOM_LCM_FEATURE=y
CONFIG_MTK_ENABLE_SPM_CHANGE_PMIC_MODE=y
```
